## conf/machine/agilex-extra.conf
```bitbake
#@TYPE: Machine
#@NAME: Intel SoCFPGA Agilex
#@DESCRIPTION: Additional machine configuration for the Agilex SoCFPGA

# Usage:
# Add the line below into conf/local.conf to enable additional
# settings for Agilex SoCFPGA:
# require conf/machine/agilex-extra.conf

UBOOT_CONFIG ?= "agilex-socdk-atf"

KERNEL_DEVICETREE ?= "intel/socfpga_agilex_socdk.dtb"

MACHINE_ESSENTIAL_EXTRA_RRECOMMENDS += "kernel-modules"
EXTRA_IMAGEDEPENDS += "hw-ref-design u-boot-socfpga-scr"

IMAGE_BOOT_FILES = " \
		${MACHINE}_${IMAGE_TYPE}_ghrd/ghrd.core.rbf;ghrd.core.rbf \
		u-boot.scr \
		u-boot.itb \
		${KERNEL_IMAGETYPE} \
		socfpga_agilex_socdk.dtb \
		"
```

## conf/machine/agilex.conf
```bitbake
#@TYPE: Machine
#@NAME: Intel SoCFPGA Agilex
#@DESCRIPTION: Machine configuration for the Agilex SoCFPGA

require conf/machine/include/socfpga_armv8a.inc

KBUILD_DEFCONFIG ?= "defconfig"

UBOOT_CONFIG ??= "agilex-socdk-atf"
UBOOT_BINARY = "u-boot.itb"
UBOOT_SUFFIX = "itb"

KERNEL_CLASSES += "kernel-fitimage"
KERNEL_IMAGETYPE = "fitImage"
#KERNEL_IMAGETYPE:append = " fitImage"

KERNEL_DEVICETREE ?= "intel/socfpga_agilex_socdk.dtb"
UBOOT_ENTRYPOINT = "0x4000000"
UBOOT_LOADADDRESS = "0x4000000"
FIT_KERNEL_COMP_ALG = "none"

SERIAL_CONSOLES ?= "115200;ttyS0"

EXTRA_IMAGECMD:jffs2 ?= "-n -q -e 0x10000"

# Add variables for wic creation of sdcard image
IMAGE_BOOT_FILES ?= " \
			${UBOOT_BINARY} \
			fitImage \
			socfpga_agilex_socdk.dtb \
		    "

WKS_FILE ?= "sdimage-stratix10-agilex.wks"
IMAGE_FSTYPES += "wic"
```

## conf/machine/agilex_fm86.conf
```bitbake
#@TYPE: Machine
#@NAME: Intel SoCFPGA Agilex FM86
#@DESCRIPTION: Machine configuration for the Agilex FM86 SoCFPGA

require conf/machine/agilex_fm61.conf

UBOOT_CONFIG ??= "agilex_fm86-socdk-atf"
UBOOT_CONFIG[agilex_fm86-socdk] = "socfpga_agilex_legacy_defconfig"
UBOOT_CONFIG[agilex_fm86-socdk-atf] = "socfpga_agilex_defconfig"
UBOOT_CONFIG[agilex_fm86-socdk-qspi] = "socfpga_agilex_qspi_legacy_defconfig"
UBOOT_CONFIG[agilex_fm86-socdk-qspi-atf] = "socfpga_agilex_defconfig"
```

## conf/machine/agilex_fm87.conf
```bitbake
#@TYPE: Machine
#@NAME: Intel SoCFPGA Agilex FM87
#@DESCRIPTION: Machine configuration for the Agilex FM87 SoCFPGA

require conf/machine/agilex_fm61.conf

UBOOT_CONFIG ??= "agilex_fm87-socdk-atf"
UBOOT_CONFIG[agilex_fm87-socdk] = "socfpga_agilex_legacy_defconfig"
UBOOT_CONFIG[agilex_fm87-socdk-atf] = "socfpga_agilex_defconfig"
UBOOT_CONFIG[agilex_fm87-socdk-qspi] = "socfpga_agilex_qspi_legacy_defconfig"
UBOOT_CONFIG[agilex_fm87-socdk-qspi-atf] = "socfpga_agilex_defconfig"
```

## conf/machine/agilex_fm87_linear.conf
```bitbake
#@TYPE: Machine
#@NAME: Intel SoCFPGA Agilex FM87 B2 Linear (Non-ENPIRION)
#@DESCRIPTION: Machine configuration for the Agilex FM87 B2 Linear (Non-ENPIRION) SoCFPGA

require conf/machine/agilex_fm61.conf
require conf/machine/include/ubifs.inc

UBOOT_CONFIG ??= "agilex_fm87-socdk-atf"
UBOOT_CONFIG[agilex_fm87-socdk] = "socfpga_agilex_legacy_defconfig"
UBOOT_CONFIG[agilex_fm87-socdk-atf] = "socfpga_agilex_defconfig"
UBOOT_CONFIG[agilex_fm87-socdk-qspi] = "socfpga_agilex_qspi_legacy_defconfig"
UBOOT_CONFIG[agilex_fm87-socdk-qspi-atf] = "socfpga_agilex_defconfig"
```

## conf/machine/arria10.conf
```bitbake
#@TYPE: Machine
#@NAME: arria10
#@DESCRIPTION: Machine configuration for the Arria 10 SoC" 

require conf/machine/include/socfpga.inc

SPL_BINARY = "spl/u-boot-splx4.sfp"
UBOOT_BINARY = "u-boot.img"

UBOOT_CONFIG ??= "arria10-socdk"

KMACHINE = "arria10"

EXTRA_IMAGEDEPENDS_append = " \
	${@bb.utils.contains("IMAGE_TYPE", "pr", " u-boot-socfpga-scr", "", d)} \
	${@bb.utils.contains("IMAGE_TYPE", "pr", "", " hw-ref-design", d)} \
	"

# Default kernel devicetrees
KERNEL_DEVICETREE ?= "\
			socfpga_arria10_socdk_sdmmc.dtb \
			socfpga_arria10_socdk_qspi.dtb \
			socfpga_arria10_socdk_nand.dtb \
			${@bb.utils.contains("IMAGE_TYPE", "pr", "fpga_region.dtb", "", d)} \
			${@bb.utils.contains("IMAGE_TYPE", "pr", "persona0.dtb", "", d)} \
			${@bb.utils.contains("IMAGE_TYPE", "pr", "persona1.dtb", "", d)} \
			"

MACHINE_ESSENTIAL_EXTRA_RRECOMMENDS_append = "\
					  ${@bb.utils.contains("IMAGE_TYPE", "pr", " kernel-devicetree", "", d)} \
					  ${@bb.utils.contains("IMAGE_TYPE", "pr", " hw-ref-design", "", d)} \
					  "

EXTRA_IMAGECMD_jffs2 ?= "-n -q \
	${@bb.utils.contains("IMAGE_TYPE", "nand", "-e 0x20000 -s 0x200", "", d)} \
	${@bb.utils.contains("IMAGE_TYPE", "qspi", "-e 0x10000", "", d)} \
	"

SERIAL_CONSOLES ?= "115200;ttyS0"

UBOOT_EXTLINUX ?= "1"
UBOOT_EXTLINUX_LABELS ?= "default"
UBOOT_EXTLINUX_DEFAULT_LABEL ?= "Arria10 SOCDK SDMMC"

UBOOT_EXTLINUX_MENU_DESCRIPTION_default ?= "Arria10 SOCDK SDMMC"
UBOOT_EXTLINUX_KERNEL_IMAGE_default ?= "../${KERNEL_IMAGETYPE}"
UBOOT_EXTLINUX_FDTDIR_default ?= ".."
UBOOT_EXTLINUX_CONSOLE ?= "console=ttyS0,115200n8"
UBOOT_EXTLINUX_KERNEL_ARGS_default ?= "rootwait rw earlyprintk memmap=16M$0x3F000000"
UBOOT_EXTLINUX_ROOT_default ?= "root=/dev/mmcblk0p2"

IMAGE_BOOT_FILES ?= " \
	${@bb.utils.contains("IMAGE_TYPE", "", "", "socfpga_arria10_socdk_sdmmc.dtb", d)} \
	${@bb.utils.contains("IMAGE_TYPE", "pcie", "socfpga_arria10_socdk_sdmmc.dtb", "", d)} \
	${@bb.utils.contains("IMAGE_TYPE", "sgmii", "socfpga_arria10_socdk_sdmmc.dtb", "", d)} \
	${@bb.utils.contains("IMAGE_TYPE", "tse", "socfpga_arria10_socdk_sdmmc.dtb", "", d)} \
	${@bb.utils.contains("IMAGE_TYPE", "pr", "socfpga_arria10_socdk_sdmmc.dtb", "", d)} \
	fit_spl_fpga_${IMAGE_TYPE}.itb;fit_spl_fpga.itb \
        ${KERNEL_IMAGETYPE} \
        ${UBOOT_BINARY} \
        extlinux.conf;extlinux/extlinux.conf \
	${@bb.utils.contains("IMAGE_TYPE", "pr", "boot.scr", "", d)} \
        "

WKS_FILE ?= "sdimage-arria10.wks"
IMAGE_FSTYPES +="wic"
```

## conf/machine/cyclone5.conf
```bitbake
#@TYPE: Machine
#@NAME: cyclone5
#@DESCRIPTION: Machine configuration for the Cyclone V SoC" 

require conf/machine/include/socfpga.inc

UBOOT_CONFIG ??= "cyclone5-socdk"

KMACHINE = "cyclone5"

# Default kernel devicetrees
KERNEL_DEVICETREE ?= "\
			socfpga_cyclone5_socdk.dtb \
			socfpga_cyclone5_sockit.dtb \
			socfpga_cyclone5_socrates.dtb \
			socfpga_cyclone5_de0_nano_soc.dtb \
			socfpga_cyclone5_mcvevk.dtb \
			socfpga_cyclone5_sodia.dtb \
			socfpga_cyclone5_vining_fpga.dtb \
			"

SERIAL_CONSOLES ?= "115200;ttyS0"

UBOOT_EXTLINUX ?= "1"
UBOOT_EXTLINUX_LABELS ?= "default"
UBOOT_EXTLINUX_DEFAULT_LABEL ?= "Cyclone5 SOCDK SDMMC"

UBOOT_EXTLINUX_CONSOLE ?= "console=ttyS0,115200n8"
UBOOT_EXTLINUX_ROOT:default ?= "root=/dev/mmcblk0p2"
UBOOT_EXTLINUX_MENU_DESCRIPTION:default ?= "Cyclone5 SOCDK SDMMC"
UBOOT_EXTLINUX_KERNEL_IMAGE:default ?= "../${KERNEL_IMAGETYPE}"
UBOOT_EXTLINUX_FDTDIR:default ?= ".."
UBOOT_EXTLINUX_KERNEL_ARGS:default ?= "rootwait rw earlyprintk"

EXTRA_IMAGECMD:jffs2 ?= "-e 0x10000"

IMAGE_BOOT_FILES ?= " \
	${KERNEL_DEVICETREE} \
	${KERNEL_IMAGETYPE} \
	extlinux.conf;extlinux/extlinux.conf \
	"

WKS_FILE ?= "sdimage-cyclone5-arria5.wks"
IMAGE_FSTYPES +="wic"
```

## conf/machine/n5x.conf
```bitbake
#@TYPE: Machine
#@NAME: Intel eASIC N5X
#@DESCRIPTION: Machine configuration for the N5X eASIC devices

require conf/machine/include/socfpga_armv8a.inc

KBUILD_DEFCONFIG ?= "defconfig"

UBOOT_CONFIG ??= "n5x-socdk-atf"
UBOOT_BINARY = "u-boot.itb"
UBOOT_SUFFIX = "itb"

KERNEL_CLASSES += "kernel-fitimage"
KERNEL_IMAGETYPE = "fitImage"
#KERNEL_IMAGETYPE:append = " fitImage"

KERNEL_DEVICETREE ?= "intel/socfpga_n5x_socdk.dtb"
UBOOT_ENTRYPOINT = "0x4000000"
UBOOT_LOADADDRESS = "0x4000000"
FIT_KERNEL_COMP_ALG = "none"

SERIAL_CONSOLES ?= "115200;ttyS0"

EXTRA_IMAGECMD:jffs2 ?= "-n -q -e 0x10000"

# Add variables for wic creation of sdcard image
IMAGE_BOOT_FILES ?= " \
			${UBOOT_BINARY} \
			fitImage \
			socfpga_n5x_socdk.dtb \
		    "

WKS_FILE ?= "sdimage-stratix10-agilex.wks"
IMAGE_FSTYPES += "wic"
```

## conf/machine/stratix10-extra.conf
```bitbake
#@TYPE: Machine
#@NAME: Intel SoCFPGA Stratix10
#@DESCRIPTION: Machine configuration for the Stratix 10 SoCFPGA

# Usage:
# Add the line below into conf/local.conf to enable additional
# settings for Stratix10 SoCFPGA:
# require conf/machine/stratix10-extra.conf

PREFERRED_PROVIDER_virtual/bootloader ?= "u-boot-socfpga"
PREFERRED_VERSION_u-boot-socfpga ?= "v2020.10%"
UBOOT_CONFIG ?= "stratix10-socdk-atf"

PREFERRED_VERSION_arm-trusted-firmware ?= "v2.4%"

PREFERRED_PROVIDER_virtual/kernel ?= "linux-socfpga-lts"
PREFERRED_VERSION_linux-socfpga-lts ?= "5.4%"
KERNEL_DEVICETREE ?= " \
		altera/socfpga_stratix10_socdk.dtb \
		${@bb.utils.contains("IMAGE_TYPE", "pr", "altera/base.dtb", "", d)} \
		${@bb.utils.contains("IMAGE_TYPE", "pr", "altera/persona0.dtb", "", d)} \
		${@bb.utils.contains("IMAGE_TYPE", "pr", "altera/persona1.dtb", "", d)} \
		"

MACHINE_ESSENTIAL_EXTRA_RRECOMMENDS += " \
		kernel-modules \
		${@bb.utils.contains("IMAGE_TYPE", "pr", " kernel-devicetree", "", d)} \
		${@bb.utils.contains("IMAGE_TYPE", "pr", " hw-ref-design", "", d)} \
		"

EXTRA_IMAGEDEPENDS += " \
		u-boot-socfpga-scr \
		${@bb.utils.contains("IMAGE_TYPE", "pr", "", " hw-ref-design", d)} \
		"

DISTRO_FEATURES += "systemd"
VIRTUAL-RUNTIME_init_manager ?= "systemd"

MKUBIFS_ARGS = "--min-io-size 1 --leb-size 65408 --max-leb-cnt 3011"
UBINIZE_ARGS = "--min-io-size 1 --peb-size 65536 --sub-page-size 1"

IMAGE_BOOT_FILES ?= " \
		${MACHINE}_${IMAGE_TYPE}_ghrd/ghrd.core.rbf;ghrd.core.rbf \
		u-boot.scr \
		u-boot.itb \
		${KERNEL_IMAGETYPE} \
		socfpga_stratix10_socdk.dtb \
		"

IMAGE_FSTYPES += "cpio ext3 jffs2 tar.gz ubifs"
```

## conf/machine/stratix10.conf
```bitbake
#@TYPE: Machine
#@NAME: Intel SoCFPGA Stratix10
#@DESCRIPTION: Machine configuration for the Stratix 10 SoCFPGA

require conf/machine/include/socfpga_armv8a.inc

KBUILD_DEFCONFIG ?= "defconfig"

UBOOT_CONFIG ??= "stratix10-socdk-atf"
UBOOT_BINARY = "u-boot.itb"
UBOOT_SUFFIX = "itb"

KERNEL_CLASSES += "kernel-fitimage"
KERNEL_IMAGETYPE = "fitImage"
#KERNEL_IMAGETYPE:append = " fitImage"

KERNEL_DEVICETREE ?= "altera/socfpga_stratix10_socdk.dtb"
UBOOT_ENTRYPOINT = "0x4000000"
UBOOT_LOADADDRESS = "0x4000000"
FIT_KERNEL_COMP_ALG = "none"

SERIAL_CONSOLES ?= "115200;ttyS0"

EXTRA_IMAGECMD:jffs2 ?= "-n -q -e 0x10000"

# Add variables for wic creation of sdcard image
IMAGE_BOOT_FILES ?= " \
			${UBOOT_BINARY} \
			fitImage \
			socfpga_stratix10_socdk.dtb \
		    "

WKS_FILE ?= "sdimage-stratix10-agilex.wks"
IMAGE_FSTYPES += "wic"
```
